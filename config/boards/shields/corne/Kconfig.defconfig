## config/boards/shields/corne/Kconfig.defconfig
```kconfig
if SHIELD_CORNE_LEFT

    config ZMK_KEYBOARD_NAME
        default "CORNE-L"

    config ZMK_SPLIT_BLE_ROLE_CENTRAL
        default y

endif

if SHIELD_CORNE_RIGHT

    config ZMK_KEYBOARD_NAME
        default "CORNE-R"

endif

if SHIELD_CORNE_LEFT || SHIELD_CORNE_RIGHT

    config ZMK_SPLIT
        default y

endif
```
